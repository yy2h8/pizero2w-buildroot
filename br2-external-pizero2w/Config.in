## br2-external-pizero2w/configs/raspberrypizero2w_minimal_defconfig
```kconfig
# Architecture
BR2_arm=y
BR2_cortex_a53=y
BR2_ARM_FPU_NEON_VFPV4=y
BR2_ARM_INSTRUCTIONS_THUMB2=y

# Target options
BR2_TARGET_GENERIC_HOSTNAME="pizero2w"
BR2_TARGET_GENERIC_ISSUE="Minimal Pi Zero 2W v1.0"
BR2_INIT_BUSYBOX=y
BR2_ROOTFS_DEVICE_CREATION_DYNAMIC_MDEV=y
BR2_TARGET_ENABLE_ROOT_LOGIN=y
BR2_TARGET_GENERIC_ROOT_PASSWD="changeme"
BR2_SYSTEM_DEFAULT_PATH="/bin:/sbin:/usr/bin:/usr/sbin"

# Toolchain
BR2_TOOLCHAIN_BUILDROOT=y
BR2_TOOLCHAIN_BUILDROOT_VENDOR="pizero2w"
BR2_TOOLCHAIN_BUILDROOT_MUSL=y
BR2_TOOLCHAIN_BUILDROOT_CXX=y
BR2_KERNEL_HEADERS_6_12=y
BR2_GCC_VERSION_13_X=y
BR2_GCC_ENABLE_LTO=y
BR2_GCC_ENABLE_GRAPHITE=y

# Build options
BR2_OPTIMIZE_S=y
BR2_SHARED_STATIC_LIBS=y
BR2_SSP_NONE=y
BR2_RELRO_NONE=y
BR2_FORTIFY_SOURCE_NONE=y

# Target optimization
BR2_TARGET_OPTIMIZATION="-Os -march=armv8-a+crc -mtune=cortex-a53 -mfpu=neon-vfpv4 -ffunction-sections -fdata-sections -fno-unwind-tables -fno-asynchronous-unwind-tables"
BR2_TARGET_LDFLAGS="-Wl,--gc-sections -Wl,--as-needed -Wl,-O1 -Wl,--hash-style=gnu"

# Compiler cache
BR2_CCACHE=y
BR2_CCACHE_DIR="$(HOME)/.buildroot-ccache"
BR2_CCACHE_INITIAL_SETUP="-M 5G"

# Strip and locale
BR2_STRIP_strip=y
BR2_STRIP_EXCLUDE_FILES=""
BR2_STRIP_EXCLUDE_DIRS=""
BR2_ENABLE_LOCALE_PURGE=y
BR2_ENABLE_LOCALE_WHITELIST="C en_US.UTF-8"

# Linux kernel
BR2_LINUX_KERNEL=y
BR2_LINUX_KERNEL_CUSTOM_TARBALL=y
BR2_LINUX_KERNEL_CUSTOM_TARBALL_LOCATION="$(call github,raspberrypi,linux,rpi-6.12.y)/linux-rpi-6.12.y.tar.gz"
BR2_LINUX_KERNEL_DEFCONFIG="bcm2709"
BR2_LINUX_KERNEL_CONFIG_FRAGMENT_FILES="$(BR2_EXTERNAL_BR2_EXTERNAL_PIZERO2W_PATH)/board/raspberrypizero2w/kernel-minimal.fragment"
BR2_LINUX_KERNEL_DTS_SUPPORT=y
BR2_LINUX_KERNEL_INTREE_DTS_NAME="broadcom/bcm2710-rpi-zero-2-w"
BR2_LINUX_KERNEL_NEEDS_HOST_OPENSSL=y
BR2_LINUX_KERNEL_LZ4=y

# Bootloader
BR2_PACKAGE_RPI_FIRMWARE=y
BR2_PACKAGE_RPI_FIRMWARE_BOOTCODE_BIN=y
BR2_PACKAGE_RPI_FIRMWARE_VARIANT_PI=y
BR2_PACKAGE_RPI_FIRMWARE_VARIANT_PI_CD=y
BR2_PACKAGE_RPI_FIRMWARE_CONFIG_FILE="$(BR2_EXTERNAL_BR2_EXTERNAL_PIZERO2W_PATH)/board/raspberrypizero2w/config.txt"
BR2_PACKAGE_RPI_FIRMWARE_CMDLINE_FILE="$(BR2_EXTERNAL_BR2_EXTERNAL_PIZERO2W_PATH)/board/raspberrypizero2w/cmdline.txt"
BR2_PACKAGE_RPI_FIRMWARE_INSTALL_DTB_OVERLAYS=y

# Filesystem
BR2_TARGET_ROOTFS_EXT2=y
BR2_TARGET_ROOTFS_EXT2_4=y
BR2_TARGET_ROOTFS_EXT2_SIZE="96M"
BR2_TARGET_ROOTFS_EXT2_LABEL="rootfs"
BR2_TARGET_ROOTFS_TAR=n

# System utilities
BR2_PACKAGE_BUSYBOX=y
BR2_PACKAGE_BUSYBOX_CONFIG="$(BR2_EXTERNAL_BR2_EXTERNAL_PIZERO2W_PATH)/board/raspberrypizero2w/busybox-minimal.config"
BR2_PACKAGE_BUSYBOX_SHOW_OTHERS=y
BR2_PACKAGE_UTIL_LINUX=y
BR2_PACKAGE_UTIL_LINUX_BINARIES=y
BR2_PACKAGE_UTIL_LINUX_FINDMNT=y
BR2_PACKAGE_UTIL_LINUX_LSBLK=y
BR2_PACKAGE_UTIL_LINUX_SFDISK=y
BR2_PACKAGE_E2FSPROGS=y
BR2_PACKAGE_E2FSPROGS_RESIZE2FS=y

# Documentation and help system
# Note: man command is provided by BusyBox (CONFIG_MAN=y in busybox config)
BR2_PACKAGE_LESS=y

# Wireless support
BR2_PACKAGE_IWD=y
BR2_PACKAGE_WIRELESS_REGDB=y
BR2_PACKAGE_RPI_WIFI_FIRMWARE=y

# Readline (required for iwctl and Python REPL)
BR2_PACKAGE_READLINE=y
BR2_PACKAGE_PYTHON3_READLINE=y

# SSL/TLS Support for HTTPS
BR2_PACKAGE_CA_CERTIFICATES=y
BR2_PACKAGE_OPENSSL=y
BR2_PACKAGE_LIBOPENSSL=y
BR2_PACKAGE_LIBOPENSSL_BIN=y
BR2_PACKAGE_LIBOPENSSL_ENGINES=y

# Network tools
BR2_PACKAGE_DROPBEAR=y
BR2_PACKAGE_DROPBEAR_SMALL=y
BR2_PACKAGE_DROPBEAR_DISABLE_REVERSEDNS=y
BR2_PACKAGE_DROPBEAR_LOCALOPTIONS_FILE="$(BR2_EXTERNAL_BR2_EXTERNAL_PIZERO2W_PATH)/board/raspberrypizero2w/dropbear-localoptions.h"
BR2_PACKAGE_LIBCURL=y
BR2_PACKAGE_LIBCURL_CURL=y
BR2_PACKAGE_LIBCURL_VERBOSE=n
BR2_PACKAGE_LIBCURL_OPENSSL=y

# Development tools
BR2_PACKAGE_GIT=y
BR2_PACKAGE_GIT_CURL=y

# Python 3 with pip
BR2_PACKAGE_PYTHON3=y
BR2_PACKAGE_PYTHON3_PY_PYC=y
BR2_PACKAGE_PYTHON3_PYC_ONLY=n
BR2_PACKAGE_PYTHON3_SSL=y
BR2_PACKAGE_PYTHON3_SQLITE=y
BR2_PACKAGE_PYTHON3_ZLIB=y
BR2_PACKAGE_PYTHON3_BZIP2=y
BR2_PACKAGE_PYTHON3_CURSES=y
BR2_PACKAGE_PYTHON3_DECIMAL=y
BR2_PACKAGE_PYTHON3_OSSAUDIODEV=n
BR2_PACKAGE_PYTHON3_UNICODEDATA=y
BR2_PACKAGE_PYTHON_PIP=y
BR2_PACKAGE_PYTHON_SETUPTOOLS=y

# Database support
BR2_PACKAGE_SQLITE=y
BR2_PACKAGE_SQLITE_STAT3=y
BR2_PACKAGE_SQLITE_ENABLE_FTS3=y
BR2_PACKAGE_SQLITE_ENABLE_UNLOCK_NOTIFY=y
BR2_PACKAGE_SQLITE_SECURE_DELETE=y

# Compression libraries (for Python)
BR2_PACKAGE_ZLIB=y
BR2_PACKAGE_BZIP2=y
BR2_PACKAGE_XZ=y

# Terminal library (for Python curses module)
BR2_PACKAGE_NCURSES=y
BR2_PACKAGE_NCURSES_TARGET_PROGS=n
BR2_PACKAGE_NCURSES_ADDITIONAL_TERMINFO=""

# Debugging tools
BR2_PACKAGE_STRACE=y

# Post-build scripts
BR2_ROOTFS_POST_BUILD_SCRIPT="$(BR2_EXTERNAL_BR2_EXTERNAL_PIZERO2W_PATH)/board/raspberrypizero2w/post-build.sh"
BR2_ROOTFS_POST_IMAGE_SCRIPT="$(BR2_EXTERNAL_BR2_EXTERNAL_PIZERO2W_PATH)/board/raspberrypizero2w/post-image.sh"
BR2_ROOTFS_OVERLAY="$(BR2_EXTERNAL_BR2_EXTERNAL_PIZERO2W_PATH)/board/raspberrypizero2w/rootfs_overlay"

# Image generation
BR2_PACKAGE_HOST_GENIMAGE=y
BR2_PACKAGE_HOST_MTOOLS=y
BR2_PACKAGE_HOST_DOSFSTOOLS=y
BR2_PACKAGE_HOST_E2FSPROGS=y
```

## br2-external-pizero2w/package/uv/Config.in
```kconfig
config BR2_PACKAGE_UV
	bool "uv"
	depends on BR2_TOOLCHAIN_USES_GLIBC
	depends on BR2_arm
	help
	  An extremely fast Python package and project manager, written
	  in Rust (uv and uvx binaries).

	  This package installs the prebuilt
	  armv7-unknown-linux-gnueabihf release binaries from GitHub,
	  so it requires a glibc toolchain (the binaries link against
	  /lib/ld-linux-armhf.so.3) and does not work with musl.

	  https://docs.astral.sh/uv/
```
